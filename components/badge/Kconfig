## components/badge/Kconfig
```kconfig
menu "SHA2017 Badge"

choice SHA_BADGE_REV
    prompt "SHA Badge revision"
    default SHA_BADGE_V3
    help
        This option sets the SHA badge revision.

        - Rev1.0.0 Dev: Release candidate
          (may 2017)
        - Rev1.0.0 Dev without the MPR121 chip.
        - Rev0.1.0 Dev: Improved badge.
          (february 2017)
        - Rev0.0.1 Dev: The original development badge.
          (december 2016)
        - Plain ESP32 hardware

config SHA_BADGE_V3
    bool "Rev1.0.*"
config SHA_BADGE_V3_LITE
    bool "Rev1.0.* (without mpr121)"
config SHA_BADGE_V2
    bool "Rev0.1.0 Dev"
config SHA_BADGE_V1
    bool "Rev0.0.1 Dev"
config SHA_BADGE_NONE
    bool "Plain ESP32"
endchoice

choice SHA_BADGE_EINK_DEFAULT_TYPE
    prompt "SHA Badge e-ink default display type"
    default SHA_BADGE_EINK_DEF_DEPG0290B1
    depends on SHA_BADGE_V1 || SHA_BADGE_V2 || SHA_BADGE_V3 || SHA_BADGE_V3_LITE
    help
        The DEPG0290B1 is the cheaper alternative.
        The GDEH029A1 was the original e-ink display.

config SHA_BADGE_EINK_DEF_DEPG0290B1
    bool "DEPG0290B1"
config SHA_BADGE_EINK_DEF_GDEH029A1
    bool "GDEH029A1"
endchoice

config SHA_BADGE_INPUT_DEBUG
    bool "Enable input debug messages"
    default n
    help
        Debugging
config SHA_BADGE_EINK_DEBUG
    bool "Enable eink debug messages"
    depends on SHA_BADGE_V1 || SHA_BADGE_V2 || SHA_BADGE_V3 || SHA_BADGE_V3_LITE
    default n
    help
        Debugging

config SHA_BADGE_EINK_LUT_DEBUG
    bool "Enable eink lookup-table debug messages"
    depends on SHA_BADGE_V1 || SHA_BADGE_V2 || SHA_BADGE_V3 || SHA_BADGE_V3_LITE
    default n
    help
        Debugging

endmenu
```
